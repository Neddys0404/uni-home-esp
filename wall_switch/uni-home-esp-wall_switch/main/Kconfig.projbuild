## wall_switch/uni-home-esp-wall_switch/main/Kconfig.projbuild
```kconfig
menu "Uni-Home ESP Wall Switch Configuration"

    config WIFI_SSID
        string "WiFi SSID"
        default "******"
        help
            WiFi network SSID to connect to.

    config WIFI_PASS
        string "WiFi Password"
        default "******"
        help
            WiFi network password.

    config MQTT_USER
        string "MQTT Username"
        default "******"
        help
            MQTT Username.

    config MQTT_PASS
        string "MQTT Password"
        default "******"
        help 
            MQTT Password

    config MQTT_BASE_TOPIC
        string "Base Topic for MQTT"
        default "smarthome"
        help
            Base Topic for MQTT Command / Heartbeat Status

    config SWITCHES_NUM
        int "Number of Switches"
        default 4
        range 1 4
        help
            Choose the number of switches this device is intended to be controlling.

endmenu
```
